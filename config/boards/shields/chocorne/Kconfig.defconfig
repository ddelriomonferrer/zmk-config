## config/boards/shields/chocorne/Kconfig.defconfig
```kconfig
if SHIELD_CHOCORNE_LEFT

config ZMK_KEYBOARD_NAME
    default "CHOCORNE"

config ZMK_SPLIT_ROLE_CENTRAL
    default y

endif

if SHIELD_CHOCORNE_LEFT || SHIELD_CHOCORNE_RIGHT

config ZMK_SPLIT
    default y

endif
```

## config/boards/shields/chocorne/Kconfig.shield
```kconfig
config SHIELD_CHOCORNE_LEFT
    def_bool $(shields_list_contains,chocorne_left)

config SHIELD_CHOCORNE_RIGHT
    def_bool $(shields_list_contains,chocorne_right)
```
